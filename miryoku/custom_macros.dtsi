U_MACRO(u_macro_lang, wait-ms = <0>; bindings = <&kp LG(SPACE)>, <&tog U_EXTRA>;)
U_MACRO(u_macro_and_lang, wait-ms = <0>; bindings = <&kp LS(SPACE)>, <&tog U_EXTRA>;)
U_MACRO(u_macro_par, wait-ms = <0>; bindings = <&kp LPAR>, <&kp RPAR>, <&kp LEFT>;)
U_MACRO(u_macro_brc, wait-ms = <0>; bindings = <&kp LBRC>, <&kp RBRC>, <&kp LEFT>;)
U_MACRO(u_macro_set, wait-ms = <0>; bindings = <&kp BSLH>, <&kp LBRC>, <&kp BSLH>, <&kp RBRC>, <&kp LEFT>, <&kp LEFT>;)
U_MACRO(u_macro_bkt, wait-ms = <0>; bindings = <&kp LBKT>, <&kp RBKT>, <&kp LEFT>;)
U_MACRO(u_macro_math, wait-ms = <0>; bindings = <&kp BSLH>, <&kp LBKT>, <&kp BSLH>, <&kp RBKT>, <&kp LEFT>, <&kp LEFT>;)
U_MACRO(u_macro_inline_math, wait-ms = <0>; bindings = <&kp DLLR>, <&kp DLLR>, <&kp LEFT>;)

#define MINJAE_COMBOS_TERM 50
#define MINJAE_COMBOS_MACRO(LAYER, POSITION, BINDING) \
minjaecombos_ ## LAYER ## _ ## POSITION { \
  layers = <LAYER>; \
  key-positions = <MINJAE_COMBOS_ ## POSITION>; \
  bindings = <BINDING>; \
  timeout-ms = <MINJAE_COMBOS_TERM>; \
};

/ {
  combos {
    compatible = "zmk,combos";
    MINJAE_COMBOS_MACRO(U_BASE, LEFTRT, &u_macro_par)
    MINJAE_COMBOS_MACRO(U_BASE, LEFTRM, &u_macro_brc)
    MINJAE_COMBOS_MACRO(U_BASE, LEFTRB, &u_macro_bkt)
    MINJAE_COMBOS_MACRO(U_BASE, RIGHTLT, &kp BSLH)
    MINJAE_COMBOS_MACRO(U_BASE, RIGHTLM, &kp EQUAL)
    MINJAE_COMBOS_MACRO(U_BASE, RIGHTLB, &u_macro_set)
    
    MINJAE_COMBOS_MACRO(U_EXTRA, LEFTRT, &u_macro_par)
    MINJAE_COMBOS_MACRO(U_EXTRA, LEFTRM, &u_macro_brc)
    MINJAE_COMBOS_MACRO(U_EXTRA, LEFTRB, &u_macro_bkt)
    MINJAE_COMBOS_MACRO(U_EXTRA, RIGHTLT, &kp BSLH)
    MINJAE_COMBOS_MACRO(U_EXTRA, RIGHTLM, &kp EQUAL)
    MINJAE_COMBOS_MACRO(U_EXTRA, RIGHTLB, &u_macro_set)
  };
};

&soft_off {
    hold-time-ms = <3000>; // Only turn off it the key is held for 5 seconds or longer.
};

#define HM_TAPPING_TERM 300
#define HM_TAPPING_TERM_FAST 200
#define HM_PRIOR_IDLE 150

/ {

    behaviors {

        // Positional Homerow mods
        // Homerow mods that prevent accidental activations when rolling keys,
        // such as when typing `st` or `ne` on colemak-dh layouts or `as` on
        // qwerty.
        //
        // Works by only allowing a mod to activate within tapping-term if
        // it's on the opposite side of the keyboard or on the same side thumb
        // keys.

        // Further optimization using urob's timerless homerow mods method:
        // https://github.com/urob/zmk-config#timeless-homerow-mods
        hm_l: homerow_mods_left {
            compatible = "zmk,behavior-hold-tap";
            #binding-cells = <2>;
            bindings = <&kp>,  <&kp>;

            flavor = "balanced";
            tapping-term-ms = <HM_TAPPING_TERM>;
            quick-tap-ms = <175>;                // repeat on tap-into-hold
            require-prior-idle-ms = <HM_PRIOR_IDLE>;

            hold-trigger-key-positions = <KEYS_R KEYS_T>;
            hold-trigger-on-release;
        };

        hm_r: homerow_mods_right {
            compatible = "zmk,behavior-hold-tap";
            #binding-cells = <2>;
            bindings = <&kp>, <&kp>;

            flavor = "balanced";
            tapping-term-ms = <HM_TAPPING_TERM>;
            quick-tap-ms = <175>;
            require-prior-idle-ms = <HM_PRIOR_IDLE>;

            hold-trigger-key-positions = <KEYS_L KEYS_T>;
            hold-trigger-on-release;
        };


        // Positional Homerow mods for shift
        // Use faster tapping term and disable some features that may
        // cause false negatives.
        hm_shift_l: hm_shift_l {
            compatible = "zmk,behavior-hold-tap";
            #binding-cells = <2>;
            bindings = <&kp>, <&kp>;

            flavor = "balanced";
            tapping-term-ms = <HM_TAPPING_TERM_FAST>;
            quick-tap-ms = <175>;
            require-prior-idle-ms = <HM_PRIOR_IDLE>;

            hold-trigger-key-positions = <KEYS_R KEYS_T>;
            // hold-trigger-on-release;
        };

        hm_shift_r: hm_shift_r {
            compatible = "zmk,behavior-hold-tap";
            #binding-cells = <2>;
            bindings = <&kp>, <&kp>;

            flavor = "balanced";
            tapping-term-ms = <HM_TAPPING_TERM_FAST>;
            quick-tap-ms = <175>;
            require-prior-idle-ms = <HM_PRIOR_IDLE>;

            hold-trigger-key-positions = <KEYS_L KEYS_T>;
            // hold-trigger-on-release;
        };

        /*
         * Non-Positional Homerow Mods
         * Used for &mm_grescm_gui behavior on left hand.
         *
         * Usage: &hm LSHFT T
         * Tap: T
         * Tap-Tap-Hold: Repeat T
         * Hold: LSHIFT
         */
        hm: homerow_mods {
            compatible = "zmk,behavior-hold-tap";
            #binding-cells = <2>;
            bindings = <&kp>, <&kp>;

            flavor = "balanced";
            tapping-term-ms = <HM_TAPPING_TERM>;
            quick-tap-ms = <200>;
        };

    };
};